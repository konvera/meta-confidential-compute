## conf/layer.conf
```bitbake
# We have a conf and classes directory, append to BBPATH
BBPATH .= ":${LAYERDIR}"

# We have a recipes directory, add to BBFILES
BBFILES += "${LAYERDIR}/recipes*/*/*.bb ${LAYERDIR}/recipes*/*/*.bbappend"

BBFILE_COLLECTIONS += "confidential-compute"
BBFILE_PATTERN_confidential-compute := "^${LAYERDIR}/"
BBFILE_PRIORITY_confidential-compute = "20"
LAYERVERSION_confidential-compute = "4"
LAYERSERIES_COMPAT_confidential-compute = "scarthgap"
```

## wic/mkefiinitrd.wks
```
# short-description: Create an EFI disk image
# long-description: Creates a partitioned EFI disk image that the user
# can directly dd to boot media.

part /boot --source bootimg-efi --sourceparams="loader=systemd-boot,create-unified-kernel-image=true,initrd=${INITRAMFS_IMAGE}-${MACHINE}.${INITRAMFS_FSTYPES}" --ondisk sda --label msdos --active --align 1024
part /data --ondisk sda --label platform --align 1024 --size 128 --use-uuid

bootloader --ptable gpt --timeout=0 --append="console=ttyS0,115200 console=tty0 ramdisk_size=402653184"
```
